## src/audio/Kconfig
```kconfig
menu "Audio components"

config COMP_VOLUME
	bool "Volume component"
	default y
	help
	  Select for Volume component

config COMP_SRC
	bool "SRC component"
	default y
	help
	  Select for SRC component

config COMP_KEYPHRASE_TEST
	bool "KEYPHRASE_TEST component"
	default y
	help
	  Select for KEYPHRASE_TEST component

endmenu
```
